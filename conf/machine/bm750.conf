## conf/machine/bm750.conf
```bitbake
#@TYPE: Machine
#@NAME: vuduo
#@DESCRIPTION: Machine configuration for the VuPlus

TARGET_ARCH = "mipsel"

PREFERRED_PROVIDER_virtual/kernel = "linux-${MACHINE}"


MACHINE_ESSENTIAL_EXTRA_RDEPENDS = "vuplus-dvb-modules"

MACHINE_ESSENTIAL_EXTRA_RDEPENDS += "kernel vuplus-dvb-modules \
	kernel-module-cifs	kernel-module-exportfs  kernel-module-isofs \
	kernel-module-reiserfs 	\
	kernel-module-sr-mod	kernel-module-usb-storage \
	kernel-module-cdrom \
	kernel-module-msdos kernel-module-vfat kernel-module-fat \
	kernel-module-libata kernel-module-ntfs kernel-module-sata-svw \
	kernel-module-nls-base kernel-module-nls-iso8859-1 kernel-module-nls-cp437 \
	kernel-module-xfs"

TARGET_FPU = "soft"

# used by sysvinit_2
#SERIAL_CONSOLE = "115200 ttyS0"


MACHINE_FEATURES += "kernel26"

TARGET_CC_ARCH = "-march=mips32"


#PREFERRED_VERSION_linux-libc-headers = "2.6.18"

DISTRO_FEATURES += " mplt"




PREFERRED_PROVIDER_task-vuplus-dvbapi = "task-vuplus-dvbapi3"
PREFERRED_PROVIDER_task-vuplus-ui = "task-vuplus-enigma2"





#GLIBC_ADDONS = "nptl" which will be set at glibc_xxx.bb. Setting here causes a configure error.
GLIBC_ADDONS ?= "ports,nptl,libidn"
GLIBC_EXTRA_OECONF = "--disable-profile --with-tls --without-fp --with-__thread"

PREFERRED_PROVIDER_xserver = "xserver-kdrive"

EXTRA_IMAGEDEPENDS += "vuplus-makenfi-native"

MACHINE_FEATURES += "alsa pci"


EXTRA_IMAGECMD_jffs2 = " --eraseblock=0x20000 -n -l "
IMAGE_CMD_jffs2 = " \
	cp ${IMAGE_ROOTFS}/boot/vmlinux.gz ${DEPLOY_DIR_IMAGE}/${IMAGE_NAME}.vmlinux.gz; \
	rm -f ${IMAGE_ROOTFS}/boot/vmlinux.gz; \
	mkfs.jffs2 --root=${IMAGE_ROOTFS}/boot --faketime \
	--disable-compressor=lzo --compression-mode=size \
       --output=${DEPLOY_DIR_IMAGE}/${IMAGE_NAME}.boot.jffs2 \
       ${EXTRA_IMAGECMD}; rm -rf ${IMAGE_ROOTFS}/boot/*; \
       rm -rf ${IMAGE_ROOTFS}/tmp/*; \
       mkfs.jffs2 --root=${IMAGE_ROOTFS} \
	--disable-compressor=lzo --compression-mode=size \
       --output=${DEPLOY_DIR_IMAGE}/${IMAGE_NAME}.rootfs.jffs2 \
       ${EXTRA_IMAGECMD}; \
       vfi3 ${DEPLOY_DIR_IMAGE}/${IMAGE_NAME}.rootfs.jffs2 ${DEPLOY_DIR_IMAGE}/${IMAGE_NAME}.boot.jffs2 ${DEPLOY_DIR_IMAGE}/${IMAGE_NAME}.vmlinux.gz > ${DEPLOY_DIR_IMAGE}/${IMAGE_NAME}.nfi"
```
